## CMakeLists.txt
```
# Copyright (c) 2026 Ivano Bilenchi
# SPDX-License-Identifier: ISC

cmake_minimum_required(VERSION 3.24)

find_package(Zephyr REQUIRED HINTS $ENV{ZEPHYR_BASE})
project(ulib_test LANGUAGES C)

set(ULIB_TYPES TINY)
set(ULIB_CONCURRENCY ON)
set(ULIB_THREAD_STACK_SIZE 8192)
set(ULIB_LTO OFF)
add_subdirectory("${CMAKE_CURRENT_LIST_DIR}/../.." ulib)

file(GLOB ULIB_TEST_SOURCES CONFIGURE_DEPENDS "${CMAKE_CURRENT_LIST_DIR}/../src/*.c")
target_sources(app PRIVATE ${ULIB_TEST_SOURCES})
target_include_directories(app PRIVATE "${CMAKE_CURRENT_LIST_DIR}/../src")
target_link_libraries(app PRIVATE ulib)
```

## prj.conf
```kconfig
CONFIG_THREAD_STACK_INFO=y
CONFIG_DYNAMIC_THREAD=y
CONFIG_DYNAMIC_THREAD_POOL_SIZE=20
CONFIG_DYNAMIC_THREAD_STACK_SIZE=8192
CONFIG_MAIN_STACK_SIZE=32768
CONFIG_TIMESLICING=y
CONFIG_TIMESLICE_SIZE=1
```

## boards/native_sim.conf
```kconfig
# Link against the host C library, so that the stream tests can reach a real filesystem.
CONFIG_EXTERNAL_LIBC=y
```

## boards/qemu_x86.conf
```kconfig
# Thread identifiers and the random number generator are thread-local. Enabled per board rather
# than globally, since the native simulator gets its own from the host toolchain.
CONFIG_THREAD_LOCAL_STORAGE=y
```

## src/libc_stubs.c
```c
/**
 * @copyright Copyright (c) 2026 Ivano Bilenchi <https://ivanobilenchi.com>
 * @copyright SPDX-License-Identifier: ISC
 *
 * Zephyr's embedded C libraries declare the file syscalls that stdio needs, but provide no
 * implementation unless a filesystem is configured. Referencing fopen, as ustream does, is
 * therefore enough to fail the link. These stubs satisfy it, and report that no filesystem is
 * present, which is what a target without one should report anyway.
 */

#include <errno.h>
#include <stddef.h>
#include <sys/types.h>

int open(char const *path, int flags, ...);
int close(int fd);
ssize_t read(int fd, void *buf, size_t count);
ssize_t write(int fd, void const *buf, size_t count);
off_t lseek(int fd, off_t offset, int whence);
int unlink(char const *path);

int open(char const *path, int flags, ...) {
    (void)path;
    (void)flags;
    errno = ENOSYS;
    return -1;
}

int close(int fd) {
    (void)fd;
    errno = ENOSYS;
    return -1;
}

ssize_t read(int fd, void *buf, size_t count) {
    (void)fd;
    (void)buf;
    (void)count;
    errno = ENOSYS;
    return -1;
}

ssize_t write(int fd, void const *buf, size_t count) {
    (void)fd;
    (void)buf;
    (void)count;
    errno = ENOSYS;
    return -1;
}

off_t lseek(int fd, off_t offset, int whence) {
    (void)fd;
    (void)offset;
    (void)whence;
    errno = ENOSYS;
    return -1;
}

int unlink(char const *path) {
    (void)path;
    errno = ENOSYS;
    return -1;
}
```
